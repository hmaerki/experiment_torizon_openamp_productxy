## conf/layer.conf
```bitbake
# We have a conf and classes directory, add to BBPATH
BBPATH .= ":${LAYERDIR}"

# We have recipes-* directories, add to BBFILES
BBFILES += "${LAYERDIR}/recipes-*/*/*.bb \
            ${LAYERDIR}/recipes-*/*/*.bbappend"

BBFILE_COLLECTIONS += "meta-productxy"
BBFILE_PATTERN_meta-productxy = "^${LAYERDIR}/"
BBFILE_PRIORITY_meta-productxy = "6"

LAYERDEPENDS_meta-productxy = "core"
LAYERSERIES_COMPAT_meta-productxy = "scarthgap"
```
